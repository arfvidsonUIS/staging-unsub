## drivers/staging/unisys/Kconfig
```kconfig
#
# Unisys SPAR driver configuration
#
menuconfig UNISYSSPAR
	bool "Unisys SPAR driver support"
	depends on X86_64
	---help---
	Support for the Unisys SPAR drivers

if UNISYSSPAR

source "drivers/staging/unisys/visorutil/Kconfig"
source "drivers/staging/unisys/visorchannel/Kconfig"
source "drivers/staging/unisys/visorchipset/Kconfig"
source "drivers/staging/unisys/uislib/Kconfig"
source "drivers/staging/unisys/virtpci/Kconfig"
source "drivers/staging/unisys/virthba/Kconfig"
source "drivers/staging/unisys/visorclientbus/Kconfig"
source "drivers/staging/unisys/visorbus/Kconfig"
source "drivers/staging/unisys/visordiag/Kconfig"
source "drivers/staging/unisys/virtnic/Kconfig"
source "drivers/staging/unisys/visornoop/Kconfig"
source "drivers/staging/unisys/visornic/Kconfig"
source "drivers/staging/unisys/visorserial/Kconfig"
source "drivers/staging/unisys/visorvideoclient/Kconfig"
source "drivers/staging/unisys/visorconinclient/Kconfig"
source "drivers/staging/unisys/sparstopdriver/Kconfig"

endif # UNISYSSPAR
```

## drivers/staging/unisys/sparstopdriver/Kconfig
```kconfig
#
# Unisys sparstop configuration
#

config UNISYS_SPARSTOP
	tristate "Unisys sparstop driver"
	depends on UNISYSSPAR
	---help---
	If you say Y here, you will enable the Unisys sparstop driver.
```

## drivers/staging/unisys/virtnic/Kconfig
```kconfig
#
# Unisys virtnic configuration
#

config UNISYS_VIRTNIC
	tristate "Unisys virtnic driver"
	depends on UNISYSSPAR && UNISYS_VISORCHIPSET && UNISYS_CHANNELSTUB && UNISYS_UISLIB && UNISYS_VIRTPCI
	---help---
	If you say Y here, you will enable the Unisys virtnic driver.
```

## drivers/staging/unisys/visorclientbus/Kconfig
```kconfig
#
# Unisys visorclientbus configuration
#

config UNISYS_VISORCLIENTBUS
	tristate "Unisys visorclientbus driver"
	depends on UNISYSSPAR && UNISYS_VISORCHIPSET && UNISYS_UISLIB
	---help---
	If you say Y here, you will enable the Unisys visorclientbus driver.
```

## drivers/staging/unisys/visorconinclient/Kconfig
```kconfig
#
# Unisys visorconinclient configuration
#

config UNISYS_VISORCONINCLIENT
	tristate "Unisys visorconinclient driver"
	depends on UNISYSSPAR && UNISYS_VISORUTIL && UNISYS_VISORCHANNEL && UNISYS_VISORBUS && FB
	---help---
	If you say Y here, you will enable the Unisys visorconinclient driver.
```

## drivers/staging/unisys/visordiag/Kconfig
```kconfig
#
# Unisys visordiag configuration
#

config UNISYS_VISORDIAG
	tristate "Unisys visordiag driver"
	depends on UNISYSSPAR && UNISYS_VISORUTIL && UNISYS_VISORCHANNEL
	---help---
	If you say Y here, you will enable the Unisys visordiag driver.
```

## drivers/staging/unisys/visorhid/Kconfig
```kconfig
#
# Unisys visorhid configuration
#

config UNISYS_VISORHID
	tristate "Unisys visorhid driver"
	depends on UNISYSSPAR && UNISYS_VISORUTIL && UNISYS_VISORCHANNEL && UNISYS_VISORBUS && FB
	---help---
	If you say Y here, you will enable the Unisys visorhid driver.
```

## drivers/staging/unisys/visornic/Kconfig
```kconfig
#
# Unisys visornic configuration
#

config UNISYS_VISORNIC
	tristate "Unisys visornic driver"
	depends on UNISYSSPAR && UNISYS_VISORUTIL && UNISYS_VISORCHANNEL && UNISYS_VISORCHIPSET && UNISYS_VISORBUS
	---help---
	If you say Y here, you will enable the Unisys visornic driver.
```

## drivers/staging/unisys/visornoop/Kconfig
```kconfig
#
# Unisys visornoop configuration
#

config UNISYS_VISORNOOP
	tristate "Unisys visornoop driver"
	depends on UNISYSSPAR && UNISYS_VISORUTIL && UNISYS_VISORBUS
	---help---
	If you say Y here, you will enable the Unisys visornoop driver.
```

## drivers/staging/unisys/visorserial/Kconfig
```kconfig
#
# Unisys visorserial configuration
#

config UNISYS_VISORSERIAL
	tristate "Unisys visorserial driver"
	depends on UNISYSSPAR && UNISYS_VISORUTIL && UNISYS_VISORCHANNEL
	---help---
	If you say Y here, you will enable the Unisys visorserial driver.
```

## drivers/staging/unisys/visorvideoclient/Kconfig
```kconfig
#
# Unisys visorvideoclient configuration
#

config UNISYS_VISORVIDEOCLIENT
	tristate "Unisys visorvideoclient driver"
	depends on UNISYSSPAR && UNISYS_VISORUTIL && UNISYS_VISORBUS
	---help---
	If you say Y here, you will enable the Unisys visorvideoclient driver.
```
